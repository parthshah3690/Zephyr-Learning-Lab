## CMakeLists.txt
```
cmake_minimum_required(VERSION 3.20.0)

find_package(Zephyr REQUIRED HINTS $ENV{ZEPHYR_BASE})

project(zephyr_logging)

target_sources(app PRIVATE 
                    src/main.c
                    src/system_manager.c
                    src/sensor_manager.c
                    src/communication_manager.c
                    src/power_manager.c
)
```

## prj.conf
```kconfig
CONFIG_LOG=y
CONFIG_LOG_DEFAULT_LEVEL=3
CONFIG_LOG_BACKEND_SHOW_COLOR=y
```

## src/main.c
```c
#include <zephyr/kernel.h>
#include <zephyr/logging/log.h>

LOG_MODULE_REGISTER(main);

void power_manager_init(void);
void system_manager_init(void);
void sensor_manager_process(void);
void communication_manager_process(void);

int main(void)
{
    LOG_INF("Zephyr Logging started!");

    power_manager_init();
    system_manager_init();

    while (true)
    {
        sensor_manager_process();
        communication_manager_process();

        k_sleep(K_SECONDS(1));
    }
    return 0;
}
```

## src/communication_manager.c
```c
#include <zephyr/logging/log.h>

LOG_MODULE_REGISTER(communication_manager);

void communication_manager_process(void)
{
    static int32_t counter = 0;

    if (counter++ >= 10000)
    {
        counter = 0;
    }

    LOG_INF("Communication cycle %d", counter);

    if(counter % 5 == 0)
    {
        LOG_ERR("Communication timeout detected");
    }
}
```

## src/power_manager.c
```c
#include <zephyr/logging/log.h>

LOG_MODULE_REGISTER(power_manager);

void power_manager_init(void)
{
    LOG_INF("Power management initialized");
}
```

## src/sensor_manager.c
```c
#include <zephyr/logging/log.h>

LOG_MODULE_REGISTER(sensor_manager);

void sensor_manager_process(void)
{
    static int32_t temperature = 25;
    LOG_INF("Temperature value : %d degC", temperature);

    if (temperature > 30)
    {
        LOG_WRN("Temperature is high");
    }
    temperature++;
}
```

## src/system_manager.c
```c
#include <zephyr/logging/log.h>

LOG_MODULE_REGISTER(system_manager);

void system_manager_init(void)
{
    LOG_INF("System initialization started");
    LOG_DBG("Checking hardware configuration");
    LOG_INF("System initialization completed");
}
```
