## CMakeLists.txt
```
cmake_minimum_required(VERSION 3.20.0)

find_package(Zephyr REQUIRED HINTS $ENV{ZEPHYR_BASE})

project(zephyr_logging)

target_sources(app PRIVATE 
                    src/main.c
                    src/system_manager.c
                    src/sensor_manager.c
                    src/comm_manager.c
                    src/power_manager.c
)

target_include_directories(app PRIVATE inc)
```

## prj.conf
```kconfig
CONFIG_LOG=y
CONFIG_LOG_DEFAULT_LEVEL=3

CONFIG_THREAD_NAME=y
CONFIG_THREAD_STACK_INFO=y
CONFIG_THREAD_ANALYZER=y
```

## inc/common.h
```c
#ifndef _COMMON_H_
#define _COMMON_H_

#include <comm_manager.h>
#include <power_manager.h>
#include <sensor_manager.h>
#include <system_manager.h>

#endif // _COMMON_H_
```

## inc/system_manager.h
```c
#ifndef _SYSTEM_MANAGER_H_
#define _SYSTEM_MANAGER_H_

#include <zephyr/kernel.h>
#include <zephyr/logging/log.h>

extern void system_manager_init(void);
extern void system_manager_thread(void* p1, void* p2, void* p3);

#endif // _SYSTEM_MANAGER_H_
```

## src/comm_manager.c
```c
#include "comm_manager.h"

LOG_MODULE_REGISTER(comm_manager);

void comm_manager_thread(void* p1, void* p2, void* p3)
{
    ARG_UNUSED(p1);
    ARG_UNUSED(p2);
    ARG_UNUSED(p3);

    while (true) 
    {
        LOG_INF("Communication status OK");

        k_sleep(K_SECONDS(3));
    }
}
```

## src/power_manager.c
```c
#include "power_manager.h"

LOG_MODULE_REGISTER(power_manager);

typedef enum
{
    POWER_INIT,
    POWER_ACTIVE,
    POWER_IDLE,
    POWER_SLEEP
}power_state_t;

static power_state_t state = POWER_INIT;

void power_manager_init(void)
{
    state = POWER_INIT;
    LOG_INF("Power management initialized");
}

void power_manager_thread(void* p1, void* p2, void* p3)
{

    ARG_UNUSED(p1);
    ARG_UNUSED(p2);
    ARG_UNUSED(p3);

    while (true)
    {
        switch (state)
        {
            case POWER_INIT:
            {
                LOG_INF("Power state : INIT");
                state = POWER_ACTIVE;
                break;
            }

            case POWER_ACTIVE:
            {
                LOG_INF("Power state : ACTIVE");
                state = POWER_IDLE;
                break;
            }

            case POWER_IDLE:
            {
                LOG_INF("Power state : IDLE");
                state = POWER_SLEEP;
                break;
            }

            case POWER_SLEEP:
            {
                LOG_INF("Power state : SLEEP");
                state = POWER_ACTIVE;
                break;
            }
        
            default:
            {
                state = POWER_ACTIVE;
                break;
            }
        }

        k_sleep(K_SECONDS(10));
    }
}
```

## src/sensor_manager.c
```c
#include "sensor_manager.h"

LOG_MODULE_REGISTER(sensor_manager);

void sensor_manager_thread(void* p1, void* p2, void* p3)
{
    ARG_UNUSED(p1);
    ARG_UNUSED(p2);
    ARG_UNUSED(p3);
    
    int temperature = 25;

    while (true)
    {
        LOG_INF("Temperature value : %d degC", temperature);

        temperature++;

        k_sleep(K_SECONDS(1));
    }
    

}
```

## src/system_manager.c
```c
#include "system_manager.h"

LOG_MODULE_REGISTER(system_manager);

void system_manager_init(void)
{
    LOG_INF("System initialization started");
    LOG_DBG("Checking hardware configuration");
    LOG_INF("System initialization completed");
}

void system_manager_thread(void* p1, void* p2, void* p3)
{
    ARG_UNUSED(p1);
    ARG_UNUSED(p2);
    ARG_UNUSED(p3);

    while(true)
    {
        LOG_INF("System health check running...");
        k_sleep(K_SECONDS(5));
    }
}
```
